## meta-homeauto/conf/layer.conf
```bitbake
# We have a conf and classes directory, add to BBPATH
BBPATH .= ":${LAYERDIR}"

# We have recipes-* directories, add to BBFILES
BBFILES += "${LAYERDIR}/recipes-*/*/*.bb \
            ${LAYERDIR}/recipes-*/*/*.bbappend"

BBFILE_COLLECTIONS += "meta-homeauto"
BBFILE_PATTERN_meta-homeauto = "^${LAYERDIR}/"
BBFILE_PRIORITY_meta-homeauto = "6"

LAYERDEPENDS_homeauto = " \
    core \
    meta-openembedded \
    meta-python \
    meta-networking \
    meta-virtualization \
"

LAYERSERIES_COMPAT_meta-homeauto = "scarthgap"
```
